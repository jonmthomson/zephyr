## drivers/usb/udc/Kconfig.mcux
```kconfig
config UDC_MCUX
	bool "NXP MCUX USB device controller driver"
	default y
	depends on DT_HAS_NXP_MCUX_USBD_ENABLED
	help
	  NXP MCUX USB device controller driver for MXRT and LPC SoC's.

if UDC_MCUX

choice UDC_MCUX_CONTROLLER_TYPE
	prompt "USB Controller type"
	help
	  Select the type of controller available in the SoC.

config UDC_DC_NXP_EHCI
	bool "MXRT EHCI USB Device Controller"
	select NOCACHE_MEMORY if HAS_MCUX_CACHE
	select USB_DC_HAS_HS_SUPPORT
	help
	  Kinetis and RT EHCI USB Device Controller Driver.

config UDC_DC_NXP_LPCIP3511
	bool "LPC USB Device Controller"
	select USB_DC_HAS_HS_SUPPORT
	help
	  LPC USB Device Controller Driver.

endchoice

config UDC_DC_MSG_QUEUE_LEN
	int
	default 10
	help
	  Maximum number of messages USB device controller interrupt can queue
	  for callback thread

config UDC_MCUX_THREAD_STACK_SIZE
	int "Stack size for the USB driver"
	default 1024
	help
	  Size of the stack used for the internal USB thread.

endif # USB_MCUX
```
